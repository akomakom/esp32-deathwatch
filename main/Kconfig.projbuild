## main/Kconfig.projbuild
```kconfig
menu "DeathWatch Configuration"

config WIFI_SSID
    string "WiFi SSID"
	default "myssid"
	help
		SSID (network name) for the example to connect to.

config WIFI_PASSWORD
    string "WiFi Password"
	default "password"
	help
		WiFi password (WPA or WPA2) for the example to use.

		Can be left blank if the network has no security set.

config SUBMIT_FREQUENCY
    int "Seconds between submitting data to the HTTPS endpoint"
	range 0 1000000
	default 3600

config SUBMIT_ON_DOOR_STATE_CHANGE
    bool "Should make the request immediately if door position changes"
	default y

config SUBMIT_HOST
    string "HTTPS host to submit data to"
	default "docs.google.com"
	help
	    If you want a valid cert for the request, you can run something like this to get the cert for the target host:
        	echo | openssl s_client -connect docs.google.com:443 2>&1 | sed -ne '/-BEGIN CERTIFICATE-/,/-END CERTIFICATE-/p'  > server_root_cert.pem


config SUBMIT_PORT
    string "HTTPS port to submit data to"
    default "443"

config SUBMIT_URI
    string "relative URI to submit data to on SUBMIT_HOST"
    default "/forms/d/<YOUR_FORM_ID_HERE>/formResponse"

config SUBMIT_FORM_DATA_TEMPLATE
    string "www-url-encoded POST data printf template, see help"
    default "ifq&entry.252694963=%1$d&entry.1251824504=%2$d&entry.1230345097=%3$s&entry.643291391=%4$d&submit=Submit"
    help
        Option 1:
        Positional parameters to the printf string, in order, are:
        %1$d: main_data->motion_count (int)
        %2$d: main_data->door (int)
        %3$s: main_data->temp (string) (use 's' due to a bug)
        %4$d: uptime in minutes (int)
        %5$d: main_data->door_raw_distance (int) - raw centimeter distance
        
        Note that you can only skip parameters from the end (1,2,3 is OK but 1,3,4 or 2,3,4 is not),
        you can however use unneeded parameters as bogus values, eg: &bogus1=%3$s&bogus2=%2$d

        Option 2:
        You can also use non-positional parameters instead (%d, %s, etc) but these options are mutually exclusive.


config SERVER_ENABLE
    bool "Enable built-in webserver on port 80"
    default y

config MOTION_PIN
    int "Number of the GPIO PIN connected to the Motion Sensor"
	range 0 34
	default 34

config LED_PIN
    int "Number of the PIN connected to the LED (TBD)"
	range 0 34
	default 5


config US_ECHO_PIN
    int "Number of the GPIO PIN connected to the Ultrasonic sensor (ECHO)"
	range 0 34
	default 4

config US_TRIG_PIN
    int "Number of the GPIO PIN connected to the Ultrasonic sensor (TRIG)"
	range 0 34
	default 15

config US_DISTANCE_OPEN_MIN
    int "Distance to door when its open (min), cm"
	range 0 900
	default 0

config US_DISTANCE_OPEN_MAX
    int "Distance to door when its open (max), cm"
	range 0 900
	default 70

config US_DISTANCE_CLOSED_MIN
    int "(not used) Distance from ceiling to door when its closed (min), cm"
	range 0 900
	default 250

config US_DISTANCE_CLOSED_MAX
    int "(not used) Distance to ceiling door when its closed (max), cm"
	range 0 900
	default 900

	default 100
config US_DISTANCE_CAR_MIN
    int "Distance from ceiling to car roof when present (min), cm"
	range 0 900

config US_DISTANCE_CAR_MAX
    int "Distance from ceiling to car roof when present (max), cm"
	range 0 900
	default 200

config TEMPERATURE_PIN
    int "Pin for reading from DS18B20 temperature sensor"
	range 0 34
	default 32


endmenu
```
